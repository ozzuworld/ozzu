## hardware/positioning/esp32-csi/sdkconfig.defaults
```kconfig
# ESP32-WROOM-32 target
CONFIG_IDF_TARGET="esp32"

# WiFi
CONFIG_ESP_WIFI_SOFTAP_SUPPORT=y
CONFIG_ESP_WIFI_CSI_ENABLED=y
CONFIG_ESP_WIFI_STA_DISCONNECTED_PM_ENABLE=n

# BLE
CONFIG_BT_ENABLED=y
CONFIG_BT_NIMBLE_ENABLED=y
CONFIG_BT_NIMBLE_MAX_CONNECTIONS=1
CONFIG_BT_NIMBLE_ROLE_CENTRAL=y
CONFIG_BT_NIMBLE_ROLE_OBSERVER=y
CONFIG_BT_NIMBLE_ROLE_PERIPHERAL=n
CONFIG_BT_NIMBLE_ROLE_BROADCASTER=n

# Partition table — need space for NVS config
CONFIG_PARTITION_TABLE_CUSTOM=y
CONFIG_PARTITION_TABLE_CUSTOM_FILENAME="partitions.csv"

# WiFi+BT coexistence (required for ESP32 shared antenna)
CONFIG_ESP32_WIFI_SW_COEXIST_ENABLE=y
CONFIG_ESP_COEX_SW_COEXIST_ENABLE=y

# Flash — 4MB (ESP32-WROOM-32)
CONFIG_ESPTOOLPY_FLASHSIZE_4MB=y

# Performance
CONFIG_FREERTOS_HZ=1000
CONFIG_ESP_DEFAULT_CPU_FREQ_MHZ_240=y

# Logging
CONFIG_LOG_DEFAULT_LEVEL_INFO=y

# Suppress NimBLE log spam
CONFIG_BT_NIMBLE_LOG_LEVEL_NONE=y
```

## tools/esp32-wg-bridge/main/Kconfig.projbuild
```kconfig
menu "ESP32 WG Bridge"

    config ESP_WG_TARGET_SSID
        string "Target WiFi SSID"
        default "CHANGE_ME_SSID"
        help
            The SSID this ESP32 will join as a station.

    config ESP_WG_TARGET_PASS
        string "Target WiFi password"
        default "CHANGE_ME_PASS"
        help
            WPA2 passphrase for the target SSID.

    config ESP_WG_LOCAL_IP
        string "Local WG IP (CIDR-less)"
        default "10.9.0.20"

    config ESP_WG_LOCAL_NETMASK
        string "Local WG netmask"
        default "255.255.255.0"

    config ESP_WG_LOCAL_PRIVKEY
        string "ESP32 WG private key (base64)"
        default "CHANGE_ME_PRIVKEY"

    config ESP_WG_PEER_PUBKEY
        string "WG hub public key (base64)"
        default "CHANGE_ME_PUBKEY"

    config ESP_WG_PEER_ENDPOINT
        string "WG hub endpoint host/IP"
        default "35.222.38.140"

    config ESP_WG_PEER_PORT
        int "WG hub endpoint port"
        default 51820

    config ESP_WG_KEEPALIVE
        int "WG persistent keepalive (seconds)"
        default 25

endmenu
```
